## conf/layer.conf
```bitbake
# We have a conf and classes directory, append to BBPATH
BBPATH := "${LAYERDIR}:${BBPATH}"

# We have a recipes directory, add to BBFILES
BBFILES += "${LAYERDIR}/recipes*/*/*.bb ${LAYERDIR}/recipes*/*/*.bbappend"

BBFILE_COLLECTIONS += "sunxi"
BBFILE_PATTERN_sunxi := "^${LAYERDIR}/"
BBFILE_PRIORITY_sunxi = "20"
```

## conf/machine/cubieboard.conf
```bitbake
#@TYPE: Machine
#@NAME: Cubieboard Allwinner-A10
#@DESCRIPTION: Machine configuration for the Cubieboard 1GB Cortex-A8

DEFAULTTUNE = "cortexa8hf-neon"
require conf/machine/include/tune-cortexa8.inc

TARGET_ARCH = "arm"

PREFERRED_PROVIDER_virtual/kernel = "linux-sunxi"
PREFERRED_VERSION_linux ?= "3.0"

UBOOT_MACHINE = "cubieboard"
SPL_BINARY = "sunxi-spl.bin"
KMACHINE = "cubieboard"

MACHINE_EXTRA_RRECOMMENDS = " kernel-modules"
MACHINE_FEATURES = "kernel26 wifi screen apm usbgadget usbhost vfat alsa apm ext2"
KERNEL_IMAGETYPE = "uImage"

SERIAL_CONSOLE = "115200 ttyS0"
```
